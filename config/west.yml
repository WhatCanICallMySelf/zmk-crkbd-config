## config/west.yml
```yaml
manifest:
  defaults:
    revision: v0.3
  remotes:
    - name: zmkfirmware
      url-base: https://github.com/zmkfirmware
    - name: zmk-locales
      url-base: github.com/joelspadin
  projects:
    - name: zmk
      remote: zmkfirmware
      import: app/west.yml
    - name: zmk-locales
      remote: zmk-locales
  self:
    path: config
```
